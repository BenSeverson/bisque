## components/ota/Kconfig
```kconfig
menu "Bisque OTA"

config OTA_MANIFEST_URL
    string "Firmware update manifest URL"
    default "https://github.com/BenSeverson/bisque/releases/latest/download/manifest.json"
    help
        Stable URL of the release manifest JSON. GitHub redirects the
        /releases/latest/download/ path to the newest release's asset, so
        this value never has to change between releases. Point it at a fork
        to distribute custom firmware.

config OTA_CONFIRM_DELAY_SECONDS
    int "Healthy-uptime delay before confirming a new image"
    default 60
    range 10 600
    help
        After an OTA reboot the new image runs unconfirmed for this many
        seconds. If it survives the window, rollback is canceled; otherwise
        the bootloader reverts to the previous firmware on the next boot.

config OTA_CONNECT_TIMEOUT_MS
    int "OTA HTTP connect/transfer timeout (ms)"
    default 15000
    range 2000 120000

endmenu
```

## sdkconfig.defaults
```kconfig
# Target
CONFIG_IDF_TARGET="esp32s3"

# Partition table
CONFIG_PARTITION_TABLE_CUSTOM=y
CONFIG_PARTITION_TABLE_CUSTOM_FILENAME="partitions.csv"

# Flash size (ESP32-S3-N16R8: 16MB flash)
CONFIG_ESPTOOLPY_FLASHSIZE_16MB=y

# PSRAM (ESP32-S3-N16R8: 8MB octal PSRAM)
CONFIG_SPIRAM=y
CONFIG_SPIRAM_MODE_OCT=y
CONFIG_SPIRAM_SPEED_80M=y

# CPU frequency (ESP32-S3 max: 240 MHz)
CONFIG_ESP_DEFAULT_CPU_FREQ_MHZ_240=y
CONFIG_ESP_DEFAULT_CPU_FREQ_MHZ=240

# Compiler optimization: -O2 (release/perf) instead of the -Og default.
# Faster code (snappier UI, faster TLS/OTA); slightly larger but flash is
# not a constraint (~2.4MB free in the 4MB OTA slot). Assertions kept on.
CONFIG_COMPILER_OPTIMIZATION_PERF=y

# SPIFFS
CONFIG_SPIFFS_MAX_PARTITIONS=1

# FreeRTOS
CONFIG_FREERTOS_HZ=1000
CONFIG_FREERTOS_UNICORE=n

# Main task stack (app_main initializes Wi-Fi, mDNS, SPIFFS, HTTP server, etc.
# on this stack — the 3584-byte IDF default overflows partway through startup).
CONFIG_ESP_MAIN_TASK_STACK_SIZE=8192

# HTTP Server
CONFIG_HTTPD_MAX_REQ_HDR_LEN=1024
CONFIG_HTTPD_MAX_URI_LEN=512
CONFIG_HTTPD_WS_SUPPORT=y

# Log level
CONFIG_LOG_DEFAULT_LEVEL_INFO=y

# Task watchdog
CONFIG_ESP_TASK_WDT_EN=y
CONFIG_ESP_TASK_WDT_TIMEOUT_S=10

# OTA rollback support
CONFIG_BOOTLOADER_APP_ROLLBACK_ENABLE=y

# mbedTLS memory allocation: route all TLS/crypto allocations to the 8MB
# PSRAM instead of internal RAM. The default INTERNAL_MEM_ALLOC exhausts
# internal RAM across GitHub's multi-hop OTA redirect chain (each hop is a
# fresh TLS handshake), so certificate signature verification fails with
# PSA_ERROR_INSUFFICIENT_MEMORY (-141). This also gives the 1.5MB firmware
# download headroom. Requires SPIRAM_USE_MALLOC (set above).
CONFIG_MBEDTLS_EXTERNAL_MEM_ALLOC=y

# LWIP
CONFIG_LWIP_MAX_SOCKETS=16

# LVGL
CONFIG_LV_COLOR_DEPTH_16=y
CONFIG_LV_OS_FREERTOS=y
CONFIG_LV_USE_FREERTOS_TASK_NOTIFY=y
CONFIG_LV_DRAW_THREAD_PRIO=2
# Dual-core software rendering: display_task runs on core 0, the second draw
# unit gets to schedule on core 1, parallelizing blit work with UI bookkeeping.
CONFIG_LV_DRAW_SW_DRAW_UNIT_CNT=2
CONFIG_LV_USE_DRAW_SW=y
# Theme is flat: no shadows, gradients, or alpha masks. Drop the complex SW
# renderer path to shrink the binary and trim the blend loop.
CONFIG_LV_DRAW_SW_COMPLEX=n
# Only one button radius (6 px) is in use; a 1-entry circle cache suffices.
CONFIG_LV_DRAW_SW_CIRCLE_CACHE_SIZE=1
CONFIG_LV_DRAW_SW_SUPPORT_RGB565=y
CONFIG_LV_DRAW_SW_SUPPORT_RGB565_SWAPPED=y
CONFIG_LV_DRAW_SW_SUPPORT_RGB565A8=n
CONFIG_LV_DRAW_SW_SUPPORT_RGB888=n
CONFIG_LV_DRAW_SW_SUPPORT_XRGB8888=n
CONFIG_LV_DRAW_SW_SUPPORT_ARGB8888=n
CONFIG_LV_DRAW_SW_SUPPORT_ARGB8888_PREMULTIPLIED=n
CONFIG_LV_DRAW_SW_SUPPORT_L8=n
CONFIG_LV_DRAW_SW_SUPPORT_AL88=n
CONFIG_LV_DRAW_SW_SUPPORT_A8=n
CONFIG_LV_DRAW_SW_SUPPORT_I1=n
# Right-sized for the small widget set (label, button, list, chart, image, modal
# containers). If LV_USE_ASSERT_MALLOC trips, bump back to 32.
CONFIG_LV_MEM_SIZE_KILOBYTES=24
CONFIG_LV_FONT_MONTSERRAT_14=n
CONFIG_LV_FONT_MONTSERRAT_24=y
CONFIG_LV_FONT_MONTSERRAT_36=y
CONFIG_LV_FONT_MONTSERRAT_48=y
CONFIG_LV_FONT_DEFAULT_MONTSERRAT_24=y
CONFIG_LV_USE_CHART=y
CONFIG_LV_USE_LIST=y
CONFIG_LV_USE_LABEL=y
# Read-only UI: no text selection, and no label long enough to need scroll hints.
CONFIG_LV_LABEL_TEXT_SELECTION=n
CONFIG_LV_LABEL_LONG_TXT_HINT=n
CONFIG_LV_USE_BUTTON=y
CONFIG_LV_USE_BUTTONMATRIX=y
CONFIG_LV_USE_ANIMIMG=n
CONFIG_LV_USE_ARC=n
CONFIG_LV_USE_ARCLABEL=n
CONFIG_LV_USE_BAR=n
CONFIG_LV_USE_CHECKBOX=n
CONFIG_LV_USE_DROPDOWN=n
CONFIG_LV_USE_IMAGE=y
CONFIG_LV_USE_IMAGEBUTTON=n
CONFIG_LV_USE_LINE=n
CONFIG_LV_USE_MENU=n
CONFIG_LV_USE_MSGBOX=n
CONFIG_LV_USE_SCALE=n
CONFIG_LV_USE_SPINNER=n
CONFIG_LV_USE_SLIDER=n
CONFIG_LV_USE_SWITCH=n
CONFIG_LV_USE_ROLLER=n
CONFIG_LV_USE_CANVAS=n
CONFIG_LV_USE_TABLE=n
CONFIG_LV_USE_CALENDAR=n
CONFIG_LV_USE_KEYBOARD=n
CONFIG_LV_USE_TEXTAREA=n
CONFIG_LV_USE_SPINBOX=n
CONFIG_LV_USE_SPAN=n
CONFIG_LV_USE_TABVIEW=n
CONFIG_LV_USE_TILEVIEW=n
CONFIG_LV_USE_WIN=n
CONFIG_LV_USE_LED=n
CONFIG_LV_USE_THEME_DEFAULT=n
CONFIG_LV_USE_THEME_SIMPLE=y
# Flex is used by modal_profile_picker.c to stack each row's name+subtitle.
CONFIG_LV_USE_FLEX=y
CONFIG_LV_USE_GRID=n
CONFIG_LV_USE_OBSERVER=n
CONFIG_LV_BUILD_EXAMPLES=n
CONFIG_LV_BUILD_DEMOS=n
```

## sdkconfig.defaults.debug
```kconfig
# Debug build profile — overlaid on sdkconfig.defaults via:
#   BISQUE_PROFILE=debug ./build.sh
# Re-enables -Og + full assertions and turns on the LVGL on-screen perf/mem
# overlays for on-device profiling. The default (release) build uses -O2.

CONFIG_COMPILER_OPTIMIZATION_DEBUG=y
CONFIG_COMPILER_OPTIMIZATION_ASSERTION_LEVEL=2

# LVGL on-screen overlays (FPS + CPU, heap used/frag) in the bottom corners.
# Dependency chain: PERF_MONITOR/MEM_MONITOR -> SYSMON -> OBSERVER.
# SYSMON's Kconfig doesn't declare the OBSERVER dep but its headers #error
# without it, so we have to enable both explicitly here.
CONFIG_LV_USE_OBSERVER=y
CONFIG_LV_USE_SYSMON=y
CONFIG_LV_USE_PERF_MONITOR=y
CONFIG_LV_USE_MEM_MONITOR=y
```
